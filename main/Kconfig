## main/Kconfig
```kconfig
menu "GSM Module Configuration"

    config GSM_UART_PORT_NUM
        int "GSM UART Port Number"
        default 1
        help
            UART port number connected to A7670E.

    config GSM_UART_TX_PIN
        int "GSM UART TX Pin"
        default 17
        help
            GPIO number for UART TX.

    config GSM_UART_RX_PIN
        int "GSM UART RX Pin"
        default 18
        help
            GPIO number for UART RX.

    config GSM_UART_BAUD_RATE
        int "GSM UART Baud Rate"
        default 115200

    config GSM_EMERGENCY_NUMBER
        string "Emergency Phone Number"
        default "8801521475412"

    config GSM_BUF_SIZE
        int "GSM UART Buffer Size"
        default 1024

endmenu
```

## main/Kconfig.projbuild
```kconfig
menu "Cold Storage Configuration"

    choice CONNECTION_TYPE
        prompt "Network Connection Type"
        default CONNECTION_TYPE_WIFI
        help
            Select the uplink connection method.

        config CONNECTION_TYPE_WIFI
            bool "WiFi"
        config CONNECTION_TYPE_GSM
            bool "GSM (Simulated/Placeholder)"
    endchoice

    if CONNECTION_TYPE_WIFI
        config WIFI_SSID
            string "WiFi SSID"
            default "morsed"

        config WIFI_PASSWORD
            string "WiFi Password"
            default "01521475412"
            help
                Password for the WiFi network.

        config WIFI_PROV_POP
            string "Provisioning Proof of Possession (Password)"
            default "coldstorage123"
            help
                Password used to connect to the provisioning service (SoftAP).
    endif

    if CONNECTION_TYPE_GSM
        menu "GSM module Configuration"
            config SIM7670_TX_PIN
                int "Modem TX Pin (ESP RX)"
                default 16
                help
                    GPIO pin on ESP32 connected to the modem's RX pin.

            config SIM7670_RX_PIN
                int "Modem RX Pin (ESP TX)"
                default 17
                help
                    GPIO pin on ESP32 connected to the modem's TX pin.

            config SIM7670_PWR_PIN
                int "Modem PWR Pin"
                default 21
                help
                    GPIO pin on ESP32 connected to the modem's PWR pin.
            config SIM7670_RST_PIN
                int "Modem RST Pin"
                default 20
                help
                    GPIO pin on ESP32 connected to the modem's RST pin.

            config SIM7670_DTR_PIN
                int "Modem DTR Pin"
                default 45
                help
                    GPIO pin on ESP32 connected to the modem's DTR pin.

            config SIM7670_BAUD_RATE
                int "GSM UART Baud Rate"
                default 115200
                help
                    Baud rate for communication with the modem.

            choice SIM_NAME
                prompt "Network Connection Type"
                default SIM_NAME_GP
                help
                    Select the uplink connection method.

                config SIM_NAME_ROBI
                    bool "ROBI"
                config SIM_NAME_GP
                    bool "GP"
                config SIM_NAME_TELETALK
                    bool "TELETALK"
                config SIM_NAME_AIRTEL
                    bool "AIRTEL"
            endchoice

        endmenu # GPIO Configuration

        if SIM_NAME_GP
            config SIM7670_APN
                string "APN for SIM Card"
                default "gpinternet"
                help
                    Access Point Name for your SIM card provider.
        endif
    endif

    config ENABLE_MQTT
        bool "Enable MQTT Reporting"
        default y
        help
            Enable MQTT reporting for the selected connection type (WiFi or GSM).

    if ENABLE_MQTT
        menu "MQTT Configuration"
            config MQTT_BROKER_URL
                string "MQTT Broker URL"
                default "mqtt://broker.hivemq.com"
                help
                    URL of the MQTT broker (e.g., mqtt://broker.hivemq.com).

            config MQTT_USERNAME
                string "MQTT Username"
                default ""
                help
                    Username for MQTT broker authentication (optional).

            config MQTT_PASSWORD
                string "MQTT Password"
                default ""
                help
                    Password for MQTT broker authentication (optional).

            config MQTT_PUB_TOPIC_BASE
                string "MQTT Publish Topic Base"
                default "cold_storage/data"

            config MQTT_SUB_TOPIC_BASE
                string "MQTT Subscribe Topic Base"
                default "cold_storage/commands"

            config MQTT_MAC_TOPIC
                string "MQTT MAC Topic"
                default "01521475412"
            
        endmenu
    endif


    if CONNECTION_TYPE_GSM
        menu "SMS Configuration"
            config SMS_ENABLE
                bool "Enable SMS Feature"
                default n
                help
                    Placeholder to enable SMS functionality in the future.

            config TARGET_PHONE_NUMBER
                string "Target Phone Number"
                default "+8801521475412"
                help
                    The phone number to send SMS messages to or use as default emergency number.
        endmenu # SMS Configuration
    endif

    menu "Sensor GPIO Configuration"
        config DHT22_GPIO
            int "DHT22 Data Pin"
            default 18
        config DS18B20_GPIO
            int "DS18B20 Data Pin"
            default 19

        config DS18B20_FALLBACK_TEMP
            int "Fallback Temperature if Disconnected"
            default -127
            help
                Temperature value to use when DS18B20 is not connected.
    endmenu

endmenu
```
